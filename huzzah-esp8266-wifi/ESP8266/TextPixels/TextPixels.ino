/* LED Text Scroller!
 * Edited by LB for the Adafruit Feather HUZZAH ESP8266 * 
 */

#include <ESP8266WiFi.h>
#include <Adafruit_NeoPixel.h>


#ifdef __AVR__
  #include <avr/power.h>
#endif

#define PIN 15

// Parameter 1 = number of pixels in strip
// Parameter 2 = Arduino pin number (most are valid)
// Parameter 3 = pixel type flags, add together as needed:
//   NEO_KHZ800  800 KHz bitstream (most NeoPixel products w/WS2812 LEDs)
//   NEO_KHZ400  400 KHz (classic 'v1' (not v2) FLORA pixels, WS2811 drivers)
//   NEO_GRB     Pixels are wired for GRB bitstream (most NeoPixel products)
//   NEO_RGB     Pixels are wired for RGB bitstream (v1 FLORA pixels, not v2)
//   NEO_RGBW    Pixels are wired for RGBW bitstream (NeoPixel RGBW products)
Adafruit_NeoPixel strip = Adafruit_NeoPixel(32, PIN, NEO_GRB + NEO_KHZ800);


// 
//  Font data for C64 Pro 6pt
// 

// Character bitmaps for C64 Pro 6pt
const byte c64Pro_6ptBitmaps[] = 
{
  // @0 ' ' (8 pixels wide)
  //         
  //         
  //         
  //         
  //         
  //         
  //         
  //   
  // CHANGED TO @ !  
  0x00, 0x00, 0x00, 0x00, 0x00, 0x00, 0x00, 0x00,

  // @8 '!' (8 pixels wide)
  //    ##   
  //    ##   
  //    ##   
  //    ##   
  //         
  //         
  //    ##   
  //         
  0x00, 0x00, 0x00, 0x4F, 0x4F, 0x00, 0x00, 0x00, 

  // @16 '"' (8 pixels wide)
  //  ##  ## 
  //  ##  ## 
  //  ##  ## 
  //         
  //         
  //         
  //         
  //         
  0x00, 0x07, 0x07, 0x00, 0x00, 0x07, 0x07, 0x00, 

  // @24 '#' (8 pixels wide)
  //  ##  ## 
  //  ##  ## 
  // ########
  //  ##  ## 
  // ########
  //  ##  ## 
  //  ##  ## 
  //         
  0x14, 0x7F, 0x7F, 0x14, 0x14, 0x7F, 0x7F, 0x14, 

  // @32 '$' (8 pixels wide)
  //    ##   
  //   ##### 
  //  ##     
  //   ####  
  //      ## 
  //  #####  
  //    ##   
  //         
  0x00, 0x24, 0x2E, 0x6B, 0x6B, 0x3A, 0x12, 0x00, 

  // @40 '%' (8 pixels wide)
  //  ##   # 
  //  ##  ## 
  //     ##  
  //    ##   
  //   ##    
  //  ##  ## 
  //  #   ## 
  //         
  0x00, 0x63, 0x33, 0x18, 0x0C, 0x66, 0x63, 0x00, 

  // @48 '&' (8 pixels wide)
  //  ####   
  // ##  ##  
  //  ####   
  //  ###    
  // ##  ### 
  // ##  ##  
  //  ###### 
  //         
  0x32, 0x7F, 0x4D, 0x4D, 0x77, 0x72, 0x50, 0x00, 

  // @56 ''' (8 pixels wide)
  //     ##  
  //    ##   
  //   ##    
  //         
  //         
  //         
  //         
  //         
  0x00, 0x00, 0x04, 0x06, 0x03, 0x01, 0x00, 0x00, 

  // @64 '(' (8 pixels wide)
  //     ##  
  //    ##   
  //   ##    
  //   ##    
  //   ##    
  //    ##   
  //     ##  
  //         
  0x00, 0x00, 0x1C, 0x3E, 0x63, 0x41, 0x00, 0x00, 

  // @72 ')' (8 pixels wide)
  //   ##    
  //    ##   
  //     ##  
  //     ##  
  //     ##  
  //    ##   
  //   ##    
  //         
  0x00, 0x00, 0x41, 0x63, 0x3E, 0x1C, 0x00, 0x00, 

  // @80 '*' (8 pixels wide)
  //         
  //  ##  ## 
  //   ####  
  // ########
  //   ####  
  //  ##  ## 
  //         
  //         
  0x08, 0x2A, 0x3E, 0x1C, 0x1C, 0x3E, 0x2A, 0x08, 

  // @88 '+' (8 pixels wide)
  //         
  //    ##   
  //    ##   
  //  ###### 
  //    ##   
  //    ##   
  //         
  //         
  0x00, 0x08, 0x08, 0x3E, 0x3E, 0x08, 0x08, 0x00, 

  // @96 ',' (8 pixels wide)
  //         
  //         
  //         
  //         
  //         
  //    ##   
  //    ##   
  //   ##    
  0x00, 0x00, 0x80, 0xE0, 0x60, 0x00, 0x00, 0x00, 

  // @104 '-' (8 pixels wide)
  //         
  //         
  //         
  //  ###### 
  //         
  //         
  //         
  //         
  0x00, 0x08, 0x08, 0x08, 0x08, 0x08, 0x08, 0x00, 

  // @112 '.' (8 pixels wide)
  //         
  //         
  //         
  //         
  //         
  //    ##   
  //    ##   
  //         
  0x00, 0x00, 0x00, 0x60, 0x60, 0x00, 0x00, 0x00, 

  // @120 '/' (8 pixels wide)
  //         
  //      ## 
  //     ##  
  //    ##   
  //   ##    
  //  ##     
  // ##      
  //         
  0x40, 0x60, 0x30, 0x18, 0x0C, 0x06, 0x02, 0x00, 

  // @128 '0' (8 pixels wide)
  //   ####  
  //  ##  ## 
  //  ## ### 
  //  ### ## 
  //  ##  ## 
  //  ##  ## 
  //   ####  
  //         
  0x00, 0x3E, 0x7F, 0x49, 0x45, 0x7F, 0x3E, 0x00, 

  // @136 '1' (8 pixels wide)
  //    ##   
  //    ##   
  //   ###   
  //    ##   
  //    ##   
  //    ##   
  //  ###### 
  //         
  0x00, 0x40, 0x44, 0x7F, 0x7F, 0x40, 0x40, 0x00, 

  // @144 '2' (8 pixels wide)
  //   ####  
  //  ##  ## 
  //      ## 
  //     ##  
  //   ##    
  //  ##     
  //  ###### 
  //         
  0x00, 0x62, 0x73, 0x51, 0x49, 0x4F, 0x46, 0x00, 

  // @152 '3' (8 pixels wide)
  //   ####  
  //  ##  ## 
  //      ## 
  //    ###  
  //      ## 
  //  ##  ## 
  //   ####  
  //         
  0x00, 0x22, 0x63, 0x49, 0x49, 0x7F, 0x36, 0x00, 

  // @160 '4' (8 pixels wide)
  //     ##  
  //    ###  
  //   ####  
  // ##  ##  
  // ####### 
  //     ##  
  //     ##  
  //         
  0x18, 0x18, 0x14, 0x16, 0x7F, 0x7F, 0x10, 0x00, 

  // @168 '5' (8 pixels wide)
  //  ###### 
  //  ##     
  //  #####  
  //      ## 
  //      ## 
  //  ##  ## 
  //   ####  
  //         
  0x00, 0x27, 0x67, 0x45, 0x45, 0x7D, 0x39, 0x00, 

  // @176 '6' (8 pixels wide)
  //   ####  
  //  ##  ## 
  //  ##     
  //  #####  
  //  ##  ## 
  //  ##  ## 
  //   ####  
  //         
  0x00, 0x3E, 0x7F, 0x49, 0x49, 0x7B, 0x32, 0x00, 

  // @184 '7' (8 pixels wide)
  //  ###### 
  //  ##  ## 
  //     ##  
  //    ##   
  //    ##   
  //    ##   
  //    ##   
  //         
  0x00, 0x03, 0x03, 0x79, 0x7D, 0x07, 0x03, 0x00, 

  // @192 '8' (8 pixels wide)
  //   ####  
  //  ##  ## 
  //  ##  ## 
  //   ####  
  //  ##  ## 
  //  ##  ## 
  //   ####  
  //         
  0x00, 0x36, 0x7F, 0x49, 0x49, 0x7F, 0x36, 0x00, 

  // @200 '9' (8 pixels wide)
  //   ####  
  //  ##  ## 
  //  ##  ## 
  //   ##### 
  //      ## 
  //  ##  ## 
  //   ####  
  //         
  0x00, 0x26, 0x6F, 0x49, 0x49, 0x7F, 0x3E, 0x00, 

  // @208 ':' (8 pixels wide)
  //         
  //         
  //    ##   
  //         
  //         
  //    ##   
  //         
  //         
  0x00, 0x00, 0x00, 0x24, 0x24, 0x00, 0x00, 0x00, 

  // @216 ';' (8 pixels wide)
  //         
  //         
  //    ##   
  //         
  //         
  //    ##   
  //    ##   
  //   ##    
  0x00, 0x00, 0x80, 0xE4, 0x64, 0x00, 0x00, 0x00, 

  // @224 '<' (8 pixels wide)
  //     ### 
  //    ##   
  //   ##    
  //  ##     
  //   ##    
  //    ##   
  //     ### 
  //         
  0x00, 0x08, 0x1C, 0x36, 0x63, 0x41, 0x41, 0x00, 

  // @232 '=' (8 pixels wide)
  //         
  //         
  //  ###### 
  //         
  //  ###### 
  //         
  //         
  //         
  0x00, 0x14, 0x14, 0x14, 0x14, 0x14, 0x14, 0x00, 

  // @240 '>' (8 pixels wide)
  //  ###    
  //    ##   
  //     ##  
  //      ## 
  //     ##  
  //    ##   
  //  ###    
  //         
  0x00, 0x41, 0x41, 0x63, 0x36, 0x1C, 0x08, 0x00, 

  // @248 '?' (8 pixels wide)
  //   ####  
  //  ##  ## 
  //      ## 
  //     ##  
  //    ##   
  //         
  //    ##   
  //         
  0x00, 0x02, 0x03, 0x51, 0x59, 0x0F, 0x06, 0x00, 

  // @256 '@' (8 pixels wide)
  //   ####  
  //  ##  ## 
  //  ## ### 
  //  ## ### 
  //  ##     
  //  ##   # 
  //   ####  
  //         
  // CHANGED TO SPACE!!!
  0x00, 0x3E, 0x7F, 0x41, 0x4D, 0x4F, 0x2E, 0x00,  

  // @264 'A' (8 pixels wide)
  //    ##   
  //   ####  
  //  ##  ## 
  //  ###### 
  //  ##  ## 
  //  ##  ## 
  //  ##  ## 
  //         
  0x00, 0x7C, 0x7E, 0x0B, 0x0B, 0x7E, 0x7C, 0x00, 

  // @272 'B' (8 pixels wide)
  //  #####  
  //  ##  ## 
  //  ##  ## 
  //  #####  
  //  ##  ## 
  //  ##  ## 
  //  #####  
  //         
  0x00, 0x7F, 0x7F, 0x49, 0x49, 0x7F, 0x36, 0x00, 

  // @280 'C' (8 pixels wide)
  //   ####  
  //  ##  ## 
  //  ##     
  //  ##     
  //  ##     
  //  ##  ## 
  //   ####  
  //         
  0x00, 0x3E, 0x7F, 0x41, 0x41, 0x63, 0x22, 0x00, 

  // @288 'D' (8 pixels wide)
  //  ####   
  //  ## ##  
  //  ##  ## 
  //  ##  ## 
  //  ##  ## 
  //  ## ##  
  //  ####   
  //         
  0x00, 0x7F, 0x7F, 0x41, 0x63, 0x3E, 0x1C, 0x00, 

  // @296 'E' (8 pixels wide)
  //  ###### 
  //  ##     
  //  ##     
  //  ####   
  //  ##     
  //  ##     
  //  ###### 
  //         
  0x00, 0x7F, 0x7F, 0x49, 0x49, 0x41, 0x41, 0x00, 

  // @304 'F' (8 pixels wide)
  //  ###### 
  //  ##     
  //  ##     
  //  ####   
  //  ##     
  //  ##     
  //  ##     
  //         
  0x00, 0x7F, 0x7F, 0x09, 0x09, 0x01, 0x01, 0x00, 

  // @312 'G' (8 pixels wide)
  //   ####  
  //  ##  ## 
  //  ##     
  //  ## ### 
  //  ##  ## 
  //  ##  ## 
  //   ####  
  //         
  0x00, 0x3E, 0x7F, 0x41, 0x49, 0x7B, 0x3A, 0x00, 

  // @320 'H' (8 pixels wide)
  //  ##  ## 
  //  ##  ## 
  //  ##  ## 
  //  ###### 
  //  ##  ## 
  //  ##  ## 
  //  ##  ## 
  //         
  0x00, 0x7F, 0x7F, 0x08, 0x08, 0x7F, 0x7F, 0x00, 

  // @328 'I' (8 pixels wide)
  //   ####  
  //    ##   
  //    ##   
  //    ##   
  //    ##   
  //    ##   
  //   ####  
  //         
  0x00, 0x00, 0x41, 0x7F, 0x7F, 0x41, 0x00, 0x00, 

  // @336 'J' (8 pixels wide)
  //    #### 
  //     ##  
  //     ##  
  //     ##  
  //     ##  
  //  ## ##  
  //   ###   
  //         
  0x00, 0x20, 0x60, 0x41, 0x7F, 0x3F, 0x01, 0x00, 

  // @344 'K' (8 pixels wide)
  //  ##  ## 
  //  ## ##  
  //  ####   
  //  ###    
  //  ####   
  //  ## ##  
  //  ##  ## 
  //         
  0x00, 0x7F, 0x7F, 0x1C, 0x36, 0x63, 0x41, 0x00, 

  // @352 'L' (8 pixels wide)
  //  ##     
  //  ##     
  //  ##     
  //  ##     
  //  ##     
  //  ##     
  //  ###### 
  //         
  0x00, 0x7F, 0x7F, 0x40, 0x40, 0x40, 0x40, 0x00, 

  // @360 'M' (8 pixels wide)
  // ##   ## 
  // ### ### 
  // ####### 
  // ## # ## 
  // ##   ## 
  // ##   ## 
  // ##   ## 
  //         
  0x7F, 0x7F, 0x06, 0x0C, 0x06, 0x7F, 0x7F, 0x00, 

  // @368 'N' (8 pixels wide)
  //  ##  ## 
  //  ### ## 
  //  ###### 
  //  ###### 
  //  ## ### 
  //  ##  ## 
  //  ##  ## 
  //         
  0x00, 0x7F, 0x7F, 0x0E, 0x1C, 0x7F, 0x7F, 0x00, 

  // @376 'O' (8 pixels wide)
  //   ####  
  //  ##  ## 
  //  ##  ## 
  //  ##  ## 
  //  ##  ## 
  //  ##  ## 
  //   ####  
  //         
  0x00, 0x3E, 0x7F, 0x41, 0x41, 0x7F, 0x3E, 0x00, 

  // @384 'P' (8 pixels wide)
  //  #####  
  //  ##  ## 
  //  ##  ## 
  //  #####  
  //  ##     
  //  ##     
  //  ##     
  //         
  0x00, 0x7F, 0x7F, 0x09, 0x09, 0x0F, 0x06, 0x00, 

  // @392 'Q' (8 pixels wide)
  //   ####  
  //  ##  ## 
  //  ##  ## 
  //  ##  ## 
  //  ##  ## 
  //   ####  
  //     ### 
  //         
  0x00, 0x1E, 0x3F, 0x21, 0x61, 0x7F, 0x5E, 0x00, 

  // @400 'R' (8 pixels wide)
  //  #####  
  //  ##  ## 
  //  ##  ## 
  //  #####  
  //  ####   
  //  ## ##  
  //  ##  ## 
  //         
  0x00, 0x7F, 0x7F, 0x19, 0x39, 0x6F, 0x46, 0x00, 

  // @408 'S' (8 pixels wide)
  //   ####  
  //  ##  ## 
  //  ##     
  //   ####  
  //      ## 
  //  ##  ## 
  //   ####  
  //         
  0x00, 0x26, 0x6F, 0x49, 0x49, 0x7B, 0x32, 0x00, 

  // @416 'T' (8 pixels wide)
  //  ###### 
  //    ##   
  //    ##   
  //    ##   
  //    ##   
  //    ##   
  //    ##   
  //         
  0x00, 0x01, 0x01, 0x7F, 0x7F, 0x01, 0x01, 0x00, 

  // @424 'U' (8 pixels wide)
  //  ##  ## 
  //  ##  ## 
  //  ##  ## 
  //  ##  ## 
  //  ##  ## 
  //  ##  ## 
  //   ####  
  //         
  0x00, 0x3F, 0x7F, 0x40, 0x40, 0x7F, 0x3F, 0x00, 

  // @432 'V' (8 pixels wide)
  //  ##  ## 
  //  ##  ## 
  //  ##  ## 
  //  ##  ## 
  //  ##  ## 
  //   ####  
  //    ##   
  //         
  0x00, 0x1F, 0x3F, 0x60, 0x60, 0x3F, 0x1F, 0x00, 

  // @440 'W' (8 pixels wide)
  // ##   ## 
  // ##   ## 
  // ##   ## 
  // ## # ## 
  // ####### 
  // ### ### 
  // ##   ## 
  //         
  0x7F, 0x7F, 0x30, 0x18, 0x30, 0x7F, 0x7F, 0x00, 

  // @448 'X' (8 pixels wide)
  //  ##  ## 
  //  ##  ## 
  //   ####  
  //    ##   
  //   ####  
  //  ##  ## 
  //  ##  ## 
  //         
  0x00, 0x63, 0x77, 0x1C, 0x1C, 0x77, 0x63, 0x00, 

  // @456 'Y' (8 pixels wide)
  //  ##  ## 
  //  ##  ## 
  //  ##  ## 
  //   ####  
  //    ##   
  //    ##   
  //    ##   
  //         
  0x00, 0x07, 0x0F, 0x78, 0x78, 0x0F, 0x07, 0x00, 

  // @464 'Z' (8 pixels wide)
  //  ###### 
  //      ## 
  //     ##  
  //    ##   
  //   ##    
  //  ##     
  //  ###### 
  //         
  0x00, 0x61, 0x71, 0x59, 0x4D, 0x47, 0x43, 0x00, 

  // @472 '[' (8 pixels wide)
  //   ####  
  //   ##    
  //   ##    
  //   ##    
  //   ##    
  //   ##    
  //   ####  
  //         
  0x00, 0x00, 0x7F, 0x7F, 0x41, 0x41, 0x00, 0x00, 

  // @480 '\' (8 pixels wide)
  //         
  // ##      
  //  ##     
  //   ##    
  //    ##   
  //     ##  
  //      ## 
  //         
  0x02, 0x06, 0x0C, 0x18, 0x30, 0x60, 0x40, 0x00, 

  // @488 ']' (8 pixels wide)
  //   ####  
  //     ##  
  //     ##  
  //     ##  
  //     ##  
  //     ##  
  //   ####  
  //         
  0x00, 0x00, 0x41, 0x41, 0x7F, 0x7F, 0x00, 0x00, 

  // @496 '^' (8 pixels wide)
  //    #    
  //   ###   
  //  ## ##  
  // ##   ## 
  // #     # 
  //         
  //         
  //         
  0x18, 0x0C, 0x06, 0x03, 0x06, 0x0C, 0x18, 0x00, 

  // @504 '_' (8 pixels wide)
  //         
  //         
  //         
  //         
  //         
  //         
  //         
  // ########
  0x80, 0x80, 0x80, 0x80, 0x80, 0x80, 0x80, 0x80, 

  // @512 '`' (8 pixels wide)
  //   #     
  //    #    
  //     #   
  //         
  //         
  //         
  //         
  //         
  0x00, 0x00, 0x01, 0x02, 0x04, 0x00, 0x00, 0x00, 

  // @520 'a' (8 pixels wide)
  //         
  //         
  //   ####  
  //      ## 
  //   ##### 
  //  ##  ## 
  //   ##### 
  //         
  0x00, 0x20, 0x74, 0x54, 0x54, 0x7C, 0x78, 0x00, 

  // @528 'b' (8 pixels wide)
  //         
  //  ##     
  //  ##     
  //  #####  
  //  ##  ## 
  //  ##  ## 
  //  #####  
  //         
  0x00, 0x7E, 0x7E, 0x48, 0x48, 0x78, 0x30, 0x00, 

  // @536 'c' (8 pixels wide)
  //         
  //         
  //   ####  
  //  ##     
  //  ##     
  //  ##     
  //   ####  
  //         
  0x00, 0x38, 0x7C, 0x44, 0x44, 0x44, 0x00, 0x00, 

  // @544 'd' (8 pixels wide)
  //         
  //      ## 
  //      ## 
  //   ##### 
  //  ##  ## 
  //  ##  ## 
  //   ##### 
  //         
  0x00, 0x30, 0x78, 0x48, 0x48, 0x7E, 0x7E, 0x00, 

  // @552 'e' (8 pixels wide)
  //         
  //         
  //   ####  
  //  ##  ## 
  //  ###### 
  //  ##     
  //   ####  
  //         
  0x00, 0x38, 0x7C, 0x54, 0x54, 0x5C, 0x18, 0x00, 

  // @560 'f' (8 pixels wide)
  //         
  //    ###  
  //   ##    
  //  #####  
  //   ##    
  //   ##    
  //   ##    
  //         
  0x00, 0x08, 0x7C, 0x7E, 0x0A, 0x0A, 0x00, 0x00, 

  // @568 'g' (8 pixels wide)
  //         
  //         
  //   ##### 
  //  ##  ## 
  //  ##  ## 
  //   ##### 
  //      ## 
  //  #####  
  0x00, 0x98, 0xBC, 0xA4, 0xA4, 0xFC, 0x7C, 0x00, 

  // @576 'h' (8 pixels wide)
  //         
  //  ##     
  //  ##     
  //  #####  
  //  ##  ## 
  //  ##  ## 
  //  ##  ## 
  //         
  0x00, 0x7E, 0x7E, 0x08, 0x08, 0x78, 0x70, 0x00, 

  // @584 'i' (8 pixels wide)
  //         
  //    ##   
  //         
  //   ###   
  //    ##   
  //    ##   
  //   ####  
  //         
  0x00, 0x00, 0x48, 0x7A, 0x7A, 0x40, 0x00, 0x00, 

  // @592 'j' (8 pixels wide)
  //         
  //     ##  
  //         
  //     ##  
  //     ##  
  //     ##  
  //     ##  
  //  ####   
  0x00, 0x80, 0x80, 0x80, 0xFA, 0x7A, 0x00, 0x00, 

  // @600 'k' (8 pixels wide)
  //         
  //  ##     
  //  ##     
  //  ## ##  
  //  ####   
  //  ## ##  
  //  ##  ## 
  //         
  0x00, 0x7E, 0x7E, 0x10, 0x38, 0x68, 0x40, 0x00, 

  // @608 'l' (8 pixels wide)
  //         
  //   ###   
  //    ##   
  //    ##   
  //    ##   
  //    ##   
  //   ####  
  //         
  0x00, 0x00, 0x42, 0x7E, 0x7E, 0x40, 0x00, 0x00, 

  // @616 'm' (8 pixels wide)
  //         
  //         
  // ##  ##  
  // ####### 
  // ####### 
  // ## # ## 
  // ##   ## 
  //         
  0x7C, 0x7C, 0x18, 0x38, 0x1C, 0x7C, 0x78, 0x00, 

  // @624 'n' (8 pixels wide)
  //         
  //         
  //  #####  
  //  ##  ## 
  //  ##  ## 
  //  ##  ## 
  //  ##  ## 
  //         
  0x00, 0x7C, 0x7C, 0x04, 0x04, 0x7C, 0x78, 0x00, 

  // @632 'o' (8 pixels wide)
  //         
  //         
  //   ####  
  //  ##  ## 
  //  ##  ## 
  //  ##  ## 
  //   ####  
  //         
  0x00, 0x38, 0x7C, 0x44, 0x44, 0x7C, 0x38, 0x00, 

  // @640 'p' (8 pixels wide)
  //         
  //         
  //  #####  
  //  ##  ## 
  //  ##  ## 
  //  #####  
  //  ##     
  //  ##     
  0x00, 0xFC, 0xFC, 0x24, 0x24, 0x3C, 0x18, 0x00, 

  // @648 'q' (8 pixels wide)
  //         
  //         
  //   ##### 
  //  ##  ## 
  //  ##  ## 
  //   ##### 
  //      ## 
  //      ## 
  0x00, 0x18, 0x3C, 0x24, 0x24, 0xFC, 0xFC, 0x00, 

  // @656 'r' (8 pixels wide)
  //         
  //         
  //  #####  
  //  ##  ## 
  //  ##     
  //  ##     
  //  ##     
  //         
  0x00, 0x7C, 0x7C, 0x04, 0x04, 0x0C, 0x08, 0x00, 

  // @664 's' (8 pixels wide)
  //         
  //         
  //   ##### 
  //  ##     
  //   ####  
  //      ## 
  //  #####  
  //         
  0x00, 0x48, 0x5C, 0x54, 0x54, 0x74, 0x24, 0x00, 

  // @672 't' (8 pixels wide)
  //         
  //    ##   
  //  ###### 
  //    ##   
  //    ##   
  //    ##   
  //     ### 
  //         
  0x00, 0x04, 0x04, 0x3E, 0x7E, 0x44, 0x44, 0x00, 

  // @680 'u' (8 pixels wide)
  //         
  //         
  //  ##  ## 
  //  ##  ## 
  //  ##  ## 
  //  ##  ## 
  //   ##### 
  //         
  0x00, 0x3C, 0x7C, 0x40, 0x40, 0x7C, 0x7C, 0x00, 

  // @688 'v' (8 pixels wide)
  //         
  //         
  //  ##  ## 
  //  ##  ## 
  //  ##  ## 
  //   ####  
  //    ##   
  //         
  0x00, 0x1C, 0x3C, 0x60, 0x60, 0x3C, 0x1C, 0x00, 

  // @696 'w' (8 pixels wide)
  //         
  //         
  // ##   ## 
  // ## # ## 
  // ####### 
  //  #####  
  //  ## ##  
  //         
  0x1C, 0x7C, 0x70, 0x38, 0x70, 0x7C, 0x1C, 0x00, 

  // @704 'x' (8 pixels wide)
  //         
  //         
  //  ##  ## 
  //   ####  
  //    ##   
  //   ####  
  //  ##  ## 
  //         
  0x00, 0x44, 0x6C, 0x38, 0x38, 0x6C, 0x44, 0x00, 

  // @712 'y' (8 pixels wide)
  //         
  //         
  //  ##  ## 
  //  ##  ## 
  //  ##  ## 
  //   ##### 
  //     ##  
  //  ####   
  0x00, 0x9C, 0xBC, 0xA0, 0xE0, 0x7C, 0x3C, 0x00, 

  // @720 'z' (8 pixels wide)
  //         
  //         
  //  ###### 
  //     ##  
  //    ##   
  //   ##    
  //  ###### 
  //         
  0x00, 0x44, 0x64, 0x74, 0x5C, 0x4C, 0x44, 0x00, 

  // @728 '{' (8 pixels wide)
  //     ##  
  //    ##   
  //    ##   
  //   ##    
  //    ##   
  //    ##   
  //     ##  
  //         
  0x00, 0x00, 0x08, 0x3E, 0x77, 0x41, 0x00, 0x00, 

  // @736 '|' (8 pixels wide)
  //    ##   
  //    ##   
  //    ##   
  //    ##   
  //    ##   
  //    ##   
  //    ##   
  //    ##   
  0x00, 0x00, 0x00, 0xFF, 0xFF, 0x00, 0x00, 0x00, 

  // @744 '}' (8 pixels wide)
  //   ##    
  //    ##   
  //    ##   
  //     ##  
  //    ##   
  //    ##   
  //   ##    
  //         
  0x00, 0x00, 0x41, 0x77, 0x3E, 0x08, 0x00, 0x00, 

  // @752 '~' (8 pixels wide)
  //         
  //         
  //         
  //  ###  # 
  // #  ###  
  //         
  //         
  //         
  0x10, 0x08, 0x08, 0x18, 0x10, 0x10, 0x08, 0x00, 
};




void setup() 
{
  strip.begin();
  strip.show(); // Initialize all pixels to 'off'

  Serial.begin(115200);
  Serial.println();
}

void loop() 
{
  ShowText("Hello Tiffany! ");
}


void ShowText(String text)
{ 
  int offset = 0;
  int length_bytes = text.length()*8;

  // Pad character (repeat first) but leave length unaffected
  text = text + text[0];  
  
   for (int i=0; i<length_bytes; i++) 
   {
      for (int col=0; col<4; col++) 
      {
        byte b = GetColumn(text, offset+col);
          
        for (int p=0; p<8; p++) 
        {
           int pixel = ((3-col) * 8) + p;
          
           if (bitRead(b, p) == true)
           {
              strip.setPixelColor(pixel, 30, 0, 0);
           }         
           else         
           {
              strip.setPixelColor(pixel, 0, 0, 0);
           }
        }
      }

      strip.show();
      delay(50);

      offset++;
   }
}

char FixCase(char c)
{  
  if (islower(c))
  {
    return toupper(c);
  }
  else
  {
    return c-32;
  }
}

byte GetColumn(String text, int offset)
{ 
  int which_char = (int)(offset / 8);
  char c = FixCase(text[which_char]);  
  int which_byte = offset - (which_char*8);
  int pointer = (c*8) + which_byte;

  return c64Pro_6ptBitmaps[pointer];
}



